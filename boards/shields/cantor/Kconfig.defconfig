## boards/shields/cantor/Kconfig.defconfig
```kconfig
if SHIELD_CANTOR_LEFT

config ZMK_KEYBOARD_NAME
    default "Cantor"

config ZMK_SPLIT_ROLE_CENTRAL
    default y

endif

if SHIELD_CANTOR_LEFT || SHIELD_CANTOR_RIGHT

config ZMK_SPLIT
    default y

endif
```

## boards/shields/cantor/Kconfig.shield
```kconfig
config SHIELD_CANTOR_LEFT
    def_bool $(shields_list_contains,cantor_left)

config SHIELD_CANTOR_RIGHT
    def_bool $(shields_list_contains,cantor_right)
```

## boards/shields/freezetor/Kconfig.defconfig
```kconfig
if SHIELD_FREEZETOR_LEFT

config ZMK_KEYBOARD_NAME
    default "Freezetor"

config ZMK_SPLIT_ROLE_CENTRAL
    default y

endif

if SHIELD_FREEZETOR_DONGLE

config ZMK_KEYBOARD_NAME
    default "Freezetor Dongle"

config ZMK_SPLIT_ROLE_CENTRAL
    default y

# The dongle is the central and connects to both keyboard halves.
config ZMK_SPLIT_BLE_CENTRAL_PERIPHERALS
    default 2

endif

if SHIELD_FREEZETOR_LEFT || SHIELD_FREEZETOR_RIGHT || SHIELD_FREEZETOR_DONGLE

config ZMK_SPLIT
    default y

endif
```

## boards/shields/freezetor/Kconfig.shield
```kconfig
config SHIELD_FREEZETOR_LEFT
    def_bool $(shields_list_contains,freezetor_left)

config SHIELD_FREEZETOR_RIGHT
    def_bool $(shields_list_contains,freezetor_right)

config SHIELD_FREEZETOR_DONGLE
    def_bool $(shields_list_contains,freezetor_dongle)
```
